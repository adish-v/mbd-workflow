AUTOSAR XML (schema 4-3-1)
package /Components/SwcImplementations
  swc implementation SeatBeltIndication_Impl: programming-language=C, sw-version=1.64.1, used-code-generator=Embedded Coder 7.7 (R2021b) 14-May-2021, vendor-id=0, behavior=SeatBeltIndication_IB
    code-descriptors:
      code Code
        artifact-descriptors:
          short-label=SeatBeltIndication_c, category=SWSRC
          short-label=SeatBeltIndication_h, category=SWHDR
          short-label=rtwtypes_h, category=SWHDR
    resource consumption RsrcCons_SeatBeltIndication
