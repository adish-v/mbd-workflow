AUTOSAR XML (schema 4-3-1)
package /Interfaces
  6 x sender receiver interface:
    RPort_Key
      data RPort_Key: category=VALUE, sw-calibration-access=READ-ONLY, type=Double
    RPort_SeatBeltFasten
      data RPort_SeatBeltFasten: category=VALUE, sw-calibration-access=READ-ONLY, type=Double
    RPort_Speed
      data RPort_Speed: category=VALUE, sw-calibration-access=READ-ONLY, type=Double
    RPort_SpeedLimit
      data RPort_SpeedLimit: category=VALUE, sw-calibration-access=READ-ONLY, type=Double
    RPort_BlinkPeriod
      data RPort_BlinkPeriod: category=VALUE, sw-calibration-access=READ-ONLY, type=Double
    PPort_SeatBeltIcon
      data PPort_SeatBeltIcon: category=VALUE, sw-calibration-access=READ-ONLY, type=Double
