AUTOSAR XML (schema 4-3-1)
standard types defined: Double, float64
